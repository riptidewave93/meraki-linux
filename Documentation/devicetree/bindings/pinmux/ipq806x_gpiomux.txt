## drivers/net/ethernet/apm/Kconfig
```kconfig
# For a description of the syntax of this configuration file,
# see Documentation/kbuild/kconfig-language.txt.
#

config APM_NET
        tristate "APM86xxx Network Driver"
        select APMQM
        default n
        ---help---
          This is the Network driver for APM86xxx Ethernet device.
	  
	  To compile this driver as a module, choose M here. This module will
	  be called apm_enet.
	  
config APM_NET_SKB_HEADROOM
	int "Additional skb headroom (bytes)"
	depends on APM_NET
	default "0"
	help
	  Additional receive skb headroom. Change this if requires a bigger 
	  SKB Headroom than the default for optimized performance (ie IPSEC in
	  offline security). Note, the driver will always reserve at least 
	  2 bytes to make IP header aligned.

	  If unsure, set to 0.

config APM_ENET_LRO
	bool "Large Receive offload via SlimPRO"
	select SLIMPRO_OFFLOAD
	select INET_LRO
	depends on APM_NET
        default n
	help
	  Support for large receive offload via SlimPRO for IPv4

config INET_OFFLOAD
	bool "IPv4 forwarding offload support"
	depends on APM_NET
        default n
	help
	  Add support for IPv4 forwarding offload support using the Inline
	  Classifier. Once enabled offload can be turned on and off via sysfs
	  on a per port bases.
	    echo ipv4_forward > /sys/class/net/eth0/offload
	    echo default > /sys/class/net/eth0/offload
	
config APM_ENET_SLIMPRO_IPFW
	bool "IPv4 forwarding using SlimPRO"
	select SLIMPRO_OFFLOAD
	depends on APM_NET
        default n
	help
	  Add support to performance IPv4 forwarding via SlimPRO. Packets 
	  are routed from ETHx to SlimPRO. SlimPRO forwards the packet back 
	  out with header changed accordingly.

config CLE_BRIDGE
	bool "Classifier Bridge"
	depends on APM_NET && BRIDGE && APM862xx
	default n
	help
	 Using classifier for bridging purpose. 

	
config APM_VNET
	tristate "APM86xxx Virtual Network Driver for ICC"
	select APM_NET
	default n
	help
	  This is the virtual network driver for Inter Core Communication.

	  To compile this driver as a module, choose M here. This module will
	  be called apm_vnet.
```

## drivers/net/ethernet/apm/lac/Kconfig
```kconfig
config APM_LAC
        tristate "APM86xxx Look aside Clasifier driver"
        select APM_NET
        default n
        ---help---
          This is the Look aside Clasifier driver for APM86xxx SoC.
	  
	  To compile this driver as a module, choose M here. This module will
	  be called apm_lac.
```

## drivers/net/ethernet/atheros/ag7100/Kconfig
```kconfig
config AG7100
    tristate "Atheros AR7100 GigE"
    depends on SOC_AR71XX
    help
        This enables the building of Atheros AR7100 gigE driver module.

choice
    prompt "port 0 interface"
    depends on AG7100

config AG7100_GE0_MII
    bool "MII mode"

config AG7100_GE0_RMII
    bool "RMII mode"

config AG7100_GE0_RGMII
    bool "RGMII mode"

config AG7100_GE0_GMII
    bool "GMII mode"

endchoice

config  AG7100_GE1_IS_CONNECTED
    bool "port 1 is connected to a PHY"
    depends on AG7100

choice
    prompt "port 1 interface (depends on port0)"
    depends on AG7100_GE1_IS_CONNECTED

config AG7100_GE1_RMII
    bool "RMII mode"

config AG7100_GE1_RGMII
    bool "RGMII mode"

endchoice

config AG7100_ATHRF1_PHY
    bool "Atheros F1 GigE Phy"
    depends on AG7100

config AG7100_ATHRS16_PHY
    bool "Atheros S16 Phy"
    depends on AG7100

config AG7100_ATHRS26_PHY
    bool "Atheros S26 Phy"
    depends on AG7100

# config AG7100_VITESSE_PHY
#    bool "Vitesse GigE Phy 8201"
#    depends on AG7100

config AG7100_VITESSE_8601_PHY
    bool "Vitesse GigE Phy 8601"
    depends on AG7100

config AG7100_VITESSE_8601_7395_PHY
    bool "Vitesse Gige Phy 8601 on MAC0 / VSC73XX Switch on MAC1"
    depends on VITESSE_8601_PHY

config AG7100_ICPLUS_PHY
    bool "IP Icplus Phy"
    depends on AG7100

config AG7100_REALTEK_PHY
    bool "Rtl8201"
    select MII
    depends on AG7100

config AG7100_ADM6996FC_PHY
    bool "AdmTek 6996FC"
    depends on AG7100


config  AG7100_LEN_PER_TX_DS
        int "Len per tx descriptor"
        default "1536"
	depends on (AG7100_REALTEK_PHY || AG7100_ADM6996FC_PHY || AG7100_ICPLUS_PHY) && AG7100

config  AG7100_LEN_PER_TX_DS
        int "Len per tx descriptor"
	default "512"
	depends on !(AG7100_REALTEK_PHY || AG7100_ADM6996FC_PHY || AG7100_ICPLUS_PHY) && AG7100


config  AG7100_NUMBER_TX_PKTS
        int "Number tx pkts"
        default "100"
        depends on AG7100

config  AG7100_NUMBER_RX_PKTS
        int "Number rx pkts"
        default "252"
        depends on AG7100

config  AG7100_USE_TRC
	bool "Print realtime trace on asserts, this will negatively affect performance"
	default 0
	depends on AG7100
```

## drivers/net/ethernet/atheros/ag7240/Kconfig
```kconfig
config AG7240
    tristate "Atheros AR7240 GigE"
    depends on (SOC_AR724X || SOC_AR934X)
    help
        This enables the building of Atheros AR7240 gigE driver module.

config  AG7240_GE0_IS_CONNECTED
    bool "port 0 is connected to a PHY"
    depends on AG7240

choice
    prompt "port 0 interface"
    depends on AG7240

config AG7240_GE0_MII
    bool "MII mode"

config AG7240_GE0_GMII
    bool "GMII mode"

config AG7240_GE0_RGMII
    bool "RGMII mode"
endchoice

config AG7240_RGMII_PHY
    bool "Support AR7242 RGMII Phy"
    depends on AG7240_GE0_IS_CONNECTED

config AG7240_S16_PHY
    bool "Support AR7242 S16 Switch"
    depends on AG7240_GE0_IS_CONNECTED

config AG7240_ATHRS17_PHY
    bool "Support Atheros S17 Phy"
    depends on AG7240
    depends on AG7240_GE0_IS_CONNECTED

config AG7240_VIR_PHY
    bool "Support AR7242 Virtual Switch"
    depends on AG7240_GE0_IS_CONNECTED

config  AG7240_QOS
    bool "Enable MAC 0 QOS "
    depends on AG7240

config  AG7240_GE1_IS_CONNECTED
    bool "port 1 is connected to a PHY"
    depends on AG7240

choice
    prompt "port 1 interface (depends on port0)"
    depends on AG7240_GE1_IS_CONNECTED

config AG7240_GE1_MII
    bool "MII mode"

endchoice

choice
    prompt "PHY or switch used"
    depends on AG7240

config AG7240_S26_PHY
    bool "Atheros S26 Phy"

config S26_SWITCH_ONLY_MODE
    bool "Enable switch only mode"
    depends on AG7240_S26_PHY

endchoice

config  AG7240_LEN_PER_TX_DS
        int "Len per tx descriptor"
        default "1536"
	depends on AG7240

config  AG7240_NUMBER_TX_PKTS
        int "Number tx pkts"
        default "100"
        depends on AG7240

config  AG7240_NUMBER_RX_PKTS
        int "Number rx pkts"
        default "252"
        depends on AG7240

config  AG7240_MAC_LOCATION
    hex "Memory location of MAC addresses (in flash)"
        default "0xbfff0000"
        depends on AG7240
        help
          This is the physical address in memory that contains
          the MAC addresses for the board Ethernet interfaces.  They
          are stored sequentially in 6 byte groups, for the total number
          of interfaces supported on the board.

config  AG7240_USE_TRC
	bool "Print realtime trace on asserts, this will negatively affect performance"
	default 0
	depends on AG7240
```

## drivers/net/ethernet/broadcom/gmac/et/Kconfig
```kconfig
config IPROC_GMAC
	tristate "GMAC support "
	select HND
	select ET
	select ET_47XX
	select ET_ALL_PASSIVE_ON
	depends on ARCH_IPROC
	default n
	help
	  Add GMAC  support
	
	  If unsure, say N.
```

## drivers/net/ibm_newemac/Kconfig
```kconfig
config IBM_NEW_EMAC
	tristate "IBM EMAC Ethernet support"
	depends on PPC_DCR
	select CRC32
	help
	  This driver supports the IBM EMAC family of Ethernet controllers
	  typically found on 4xx embedded PowerPC chips, but also on the
	  Axon southbridge for Cell.

config IBM_NEW_EMAC_RXB
	int "Number of receive buffers"
	depends on IBM_NEW_EMAC
	default "128"

config IBM_NEW_EMAC_TXB
	int "Number of transmit buffers"
	depends on IBM_NEW_EMAC
	default "64"

config IBM_NEW_EMAC_POLL_WEIGHT
	int "MAL NAPI polling weight"
	depends on IBM_NEW_EMAC
	default "32"

config IBM_NEW_EMAC_RX_COPY_THRESHOLD
	int "RX skb copy threshold (bytes)"
	depends on IBM_NEW_EMAC
	default "256"

config IBM_EMAC_MAL_QOS_V404
	bool "VLAN QOS support"
	depends on IBM_NEW_EMAC && 460SX
	select VLAN_8021Q
	help
	  When selected the VLAN QOS support will be enabled.	

config IBM_NEW_EMAC_RX_SKB_HEADROOM
	int "Additional RX skb headroom (bytes)"
	depends on IBM_NEW_EMAC
	default "0"
	help
	  Additional receive skb headroom. Note, that driver
	  will always reserve at least 2 bytes to make IP header
	  aligned, so usually there is no need to add any additional
	  headroom.

	  If unsure, set to 0.

config IBM_NEW_EMAC_MASK_CEXT
	bool "Mask Carrier Extension signals"
	depends on IBM_NEW_EMAC && APM82181
	default n
	help
	  During normal idle TX, continously send dummy packets to mask 
	  the Carrier Extension signals. This creates a separate BD 
	  specifically for this purpose.

	  If unsure, set to N.

config IBM_NEW_EMAC_DEBUG
	bool "Debugging"
	depends on IBM_NEW_EMAC
	default n

# The options below has to be select'ed by the respective
# processor types or platforms

config IBM_NEW_EMAC_ZMII
	bool
	default n

config IBM_NEW_EMAC_RGMII
	bool
	default n

config IBM_NEW_EMAC_TAH
	bool
	default n

config IBM_NEW_EMAC_EMAC4
	bool
	default n

config IBM_NEW_EMAC_INTR_COALESCE
	bool "Hardware Interrupt coalescing"
	depends on IBM_NEW_EMAC && (460EX || 460GT || 405EX || 460SX || APM82181)
	default y
	help
	  When selected the Ethernet interrupt coalescing is selected.

config IBM_NEW_EMAC_TX_COAL_COUNT
	int "TX Coalescence frame count (packets)"
	depends on IBM_NEW_EMAC_INTR_COALESCE
	default "16"

config IBM_NEW_EMAC_TX_COAL_TIMER
	int "TX Coalescence timer (clock ticks)"
	depends on IBM_NEW_EMAC_INTR_COALESCE
	default "1000000"

config IBM_NEW_EMAC_RX_COAL_COUNT
	int "RX Coalescence frame count (packets)"
	depends on IBM_NEW_EMAC_INTR_COALESCE
	default "1"

config IBM_NEW_EMAC_RX_COAL_TIMER
	int "RX Coalescence timer (clock ticks)"
	depends on IBM_NEW_EMAC_INTR_COALESCE
	default "1000000"

config IBM_NEW_EMAC_NO_FLOW_CTRL
	bool
	default n

config IBM_NEW_EMAC_MAL_CLR_ICINTSTAT
	bool
	default n

config IBM_NEW_EMAC_MAL_COMMON_ERR
	bool
	default n

config IBM_NEW_EMAC_SYSFS
	bool "sysfs support for IBM NEW EMAC"
        depends on IBM_NEW_EMAC
        default y
        help
          When selected, IBM NEW EMAC parameters are exported 
	  via /sys interface
```

## drivers/pci/pcie/Kconfig
```kconfig
#
# PCI Express Port Bus Configuration
#
config PCIEPORTBUS
	bool "PCI Express support"
	depends on PCI
	help
	  This automatically enables PCI Express Port Bus support. Users can
	  choose Native Hot-Plug support, Advanced Error Reporting support,
	  Power Management Event support and Virtual Channel support to run
	  on PCI Express Ports (Root or Switch).

config ATHEROS_3X3_SUPPORT
	bool "PCI Express support Atheros 3x3 PCIe card"
	depends on PCIEPORTBUS && APM82181
	help
		This automatically enables PCI Express Port Bus supports Atheros
		3x3 PCIe card. With this option, some PCIe cards will cannot run 
		correctly as PCIE NIC IntelPro/1000 PT quad port, SAS LSI 1064E.
#
# Include service Kconfig here
#
config HOTPLUG_PCI_PCIE
	tristate "PCI Express Hotplug driver"
	depends on HOTPLUG_PCI && PCIEPORTBUS
	help
	  Say Y here if you have a motherboard that supports PCI Express Native
	  Hotplug

	  To compile this driver as a module, choose M here: the
	  module will be called pciehp.

	  When in doubt, say N.

source "drivers/pci/pcie/aer/Kconfig"

#
# PCI Express ASPM
#
config PCIEASPM
	bool "PCI Express ASPM support(Experimental)"
	depends on PCI && EXPERIMENTAL && PCIEPORTBUS
	default n
	help
	  This enables PCI Express ASPM (Active State Power Management) and
	  Clock Power Management. ASPM supports state L0/L0s/L1.

	  When in doubt, say N.
config PCIEASPM_DEBUG
	bool "Debug PCI Express ASPM"
	depends on PCIEASPM
	default n
	help
	  This enables PCI Express ASPM debug support. It will add per-device
	  interface to control ASPM.
```

## drivers/poe/Kconfig
```kconfig
menuconfig POWER_OVER_ETHERNET
	tristate "Power over Ethernet support"
	help
	  Say Y here to enable Power over Ethernet (PoE) support.
	  This allows management of Power over Ethernet controllers
	  by the kernel, and monitoring/control from userspace.

config POE_PD690xx
	tristate "PD690xx PoE support"
	depends on POWER_OVER_ETHERNET
	help
	  Say Y to enable a driver for MicroSemi's PD690xx PoE
	  controllers in auto mode.
```

## drivers/power/qcom/Kconfig
```kconfig
config QCOM_APM
       bool "Qualcomm Technologies Inc platform specific APM driver"
       depends on ARCH_QCOM
       help
	Platform specific driver to manage the power source of
	memory arrays. Interfaces with regulator drivers to ensure
	SRAM Vmin requirements are met across different performance
	levels.
```

## drivers/scp/Kconfig
```kconfig
#
# Character device configuration
#

menu "SCP support"
config SCP
   tristate "SCP device interface"
   depends on (440EPX || 440GRX || 405EX || 405EXr || APM82181)
   default n
   help
     When selected the SCP device driver is provided.
endmenu
```
