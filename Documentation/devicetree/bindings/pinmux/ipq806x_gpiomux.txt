## Documentation/devicetree/bindings/pinmux/ipq806x_gpiomux.txt
```
MSM GPIO Pin Controller:

Required properties:
- compatible = "ipq806x,gpiomux";

The pins are sub nodes

FUNC
GPIOMUX_FUNC_GPIO = 0,
GPIOMUX_FUNC_1    = 1,
GPIOMUX_FUNC_2    = 2,

DRV
GPIOMUX_DRV_2MA  = 0,
GPIOMUX_DRV_4MA  = 1,
GPIOMUX_DRV_6MA  = 2,
GPIOMUX_DRV_8MA  = 3,
GPIOMUX_DRV_10MA = 4,
GPIOMUX_DRV_12MA = 5,
GPIOMUX_DRV_14MA = 6,
GPIOMUX_DRV_16MA = 7,

PULL
GPIOMUX_PULL_NONE   = 0,
GPIOMUX_PULL_DOWN   = 1,
GPIOMUX_PULL_KEEPER = 2,
GPIOMUX_PULL_UP     = 3,

DIR
GPIOMUX_IN = 0,
GPIOMUX_OUT_HIGH = 1,
GPIOMUX_OUT_LOW = 2,

- active: An array of ints specifying the state of the gpio pin when active.
  <FUNC DRV PULL DIR>
- suspended: An array of ints specifying the state of the gpio pin when not active.
  <FUNC DRV PULL DIR>

Example

gpiomux@1 {
  compatible = "ipq806x,gpiomux";
  pin@xxx {
	pin = <xxx>;
	active = <0 3 0 0>;
	suspended = <0 3 0 0>;
};
```

## arch/arm/mach-ambarella/Kconfig
```kconfig
#
# arch/arm/mach-ambarella/Kconfig
#
# History:
#	2006/12/18 - [Charles Chiou] created file
#
# Copyright (C) 2004-2009, Ambarella, Inc.
#
# This program is free software; you can redistribute it and/or modify
# it under the terms of the GNU General Public License as published by
# the Free Software Foundation; either version 2 of the License, or
# (at your option) any later version.
#
# This program is distributed in the hope that it will be useful,
# but WITHOUT ANY WARRANTY; without even the implied warranty of
# MERCHANTABILITY or FITNESS FOR A PARTICULAR PURPOSE.  See the
# GNU General Public License for more details.
#
# You should have received a copy of the GNU General Public License
# along with this program; if not, write to the Free Software
# Foundation, Inc., 59 Temple Place, Suite 330, Boston, MA 02111-1307 USA
#

if PLAT_AMBARELLA

comment "Ambarella Board"

config MACH_AMBARELLA
	bool "Generic"
	default y
	select AMBARELLA_VIN
	select AMBARELLA_VOUT
	help
	  Say Y here if you can't find suitable Board Name.

config MACH_COCONUT
	bool "Coconut"
	depends on PLAT_AMBARELLA_A5S
	default n
	select AMBARELLA_VIN
	select AMBARELLA_VOUT
	help
	  Say Y here if you are using A5S Coconut.

config MACH_DURIAN
	bool "Durian"
	depends on PLAT_AMBARELLA_A7L
	default n
	select AMBARELLA_VIN
	select AMBARELLA_VOUT
	help
	  Say Y here if you are using A7L Durian.

config MACH_ELEPHANT
	bool "Elephant"
	depends on PLAT_AMBARELLA_I1
	default n
	select AMBARELLA_VIN
	select AMBARELLA_VOUT
	select CPUFREQ_AMBARELLA_DEVICE
	help
	  Say Y here if you are using iOne Elephant.

config MACH_FILBERT
	bool "Filbert"
	depends on PLAT_AMBARELLA_A7
	default n
	select AMBARELLA_VIN
	select AMBARELLA_VOUT
	help
	  Say Y here if you are using A7 Filbert.

config MACH_GINKGO
	bool "Ginkgo"
	depends on PLAT_AMBARELLA_S2
	default n
	select AMBARELLA_VIN
	select AMBARELLA_VOUT
	help
	  Say Y here if you are using S2 ginkgo.

config MACH_HYACINTH_0
	bool "Hyacinth_0"
	depends on PLAT_AMBARELLA_A8
	default n
	help
	  Say Y here if you can't find suitable Board Name.

config MACH_HYACINTH_1
	bool "Hyacinth_1"
	depends on PLAT_AMBARELLA_A8
	default n
	help
	  Say Y here if you can't find suitable Board Name.

menu "Misc on Board Devices"

comment "Ambarella"

config AMBARELLA_VIN
	bool "Suport Vin"
	default y

config AMBARELLA_VOUT
	bool "Suport Vout"
	default y

comment "Touch"

config TOUCH_AMBARELLA_AK4183
	bool "ak4183"
	default n

config TOUCH_AMBARELLA_CHACHA_MT4D
	bool "chacha_mt4d"
	default n

config TOUCH_AMBARELLA_TM1510
	bool "tm1510"
	default n

config TOUCH_AMBARELLA_TM1726
	bool "tm1726"
	default n

config TOUCH_AMBARELLA_TM1927
        bool "tm1927"
        default n

config TOUCH_AMBARELLA_FT540
        bool "ft540"
        default n

config TOUCH_AMBARELLA_NT11001
	bool "nt11001"
	default n

comment "LCD"

config LCD_AMBARELLA_1P3831
	bool "1p3831"
	default n

comment "RTC"

config RTC_AMBARELLA_IS112022M
	bool "is112022m"
	default n

comment "Audio Codec"

config CODEC_AMBARELLA_WM8974
	bool "wm8974"
	default n

config CODEC_AMBARELLA_WM8940
	bool "wm8940"
	default n

config CODEC_AMBARELLA_WM8737
	bool "wm8737"
	default n

config CODEC_AMBARELLA_WM8994
	bool "wm8994"
	default n

config CODEC_AMBARELLA_ES8328
	bool "es8328"
	default n

config CODEC_AMBARELLA_AK4642
	bool "ak4642"
	default n

config CODEC_AMBARELLA_ALC5633
	bool "alc5633"
	default n

comment "PMIC"

config PMIC_AMBARELLA_WM831X
	bool "wm831x"
	default n

comment "cpufreq-dev"

config CPUFREQ_AMBARELLA_DEVICE
	bool "cpufreq-dev"
	default n

endmenu

endif
```

## arch/arm/mach-iproc/Kconfig
```kconfig
menu	"iProc SoC based Machine types"
	depends on MACH_IPROC

choice
	prompt "iProc SoC based board type"
	default MACH_IPROC_NS	

config MACH_NS_BU
	bool "Support Broadcom Northstar bring-up board"
	select MACH_NS
	help
	  Support for the Broadcom Northstar bring-up board.

config MACH_HX4
	bool "Support Broadcom Helix4 bring-up board"
	help
	  Support for the Broadcom Helix4 bring-up board.

config MACH_HR2
	bool "Support Broadcom Hurricane2 bring-up board"
	help
	  Support for the Broadcom Hurricane2 bring-up board.

config MACH_NSP_BU
	bool "Support Broadcom Northstar Plus bring-up board"
	select MACH_NSP
	help
	  Support for the Broadcom Northstar Plus bring-up board.

config MACH_KT2
	bool "Support Broadcom Katana2 bring-up board"
	help
	  Support for the Broadcom Katana2 bring-up board.

config MACH_MERAKI_MR26
	bool "Support Meraki MR26 access point"
	select MACH_NS
	select MACH_MERAKI_GMAC_USE_PORT
	help
	  Support for the Meraki Venom access point.

config MACH_MERAKI_KINGPIN
	bool "Support Meraki MX64 (Kingpin) Security Device"
	select MACH_NSP
	help
	  Support for the Meraki Kingpin security device (MX)

endchoice

config MACH_MERAKI_PASS_BRCM_HDR
	bool "Pass Broadcom Header through (disable on bootkernel)"
    depends on MACH_MERAKI_KINGPIN
    help
      Pass the Broadcom Network Header through. This
      is required for the production kernel (click elements
      will strip process the header) but it must be
      disabled for the bootkernel

config MACH_IPROC_EMULATION
	bool "Support  iProc emulation"
	help
	  Support for the iProc emulation.

config MACH_MERAKI_GMAC_USE_PORT_NUM
	int "Use this port to represent the state of the GMAC switch"
	default 0 if MACH_MERAKI_MR26
	depends on MACH_MERAKI_GMAC_USE_PORT
	help
	  Meraki Access Points only use one port of the switch. Therefore, we
	  declare which port that is, so we can properly pass link status
	  to the user. Note the Meraki MX devices must NOT have this set.

endmenu

config MACH_NS
        bool

config MACH_NSP
        bool

config MACH_MERAKI_GMAC_USE_PORT
	bool

config IPROC_PCIE
	tristate "PCIE support"
	select PCI
	select PCI_DOMAINS
	depends on ARCH_IPROC
	default n
	help
	  Add PCIe support

	  If unsure, say N.
```
