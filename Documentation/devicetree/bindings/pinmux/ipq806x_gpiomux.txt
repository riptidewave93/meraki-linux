## arch/mips/ath79/Kconfig
```kconfig
if ATH79

menu "Atheros AR71XX/AR724X/AR913X machine selection"

config ATH79_MACH_AP121
	bool "Atheros AP121 reference board"
	select SOC_AR933X
	select ATH79_DEV_GPIO_BUTTONS
	select ATH79_DEV_LEDS_GPIO
	select ATH79_DEV_SPI
	select ATH79_DEV_USB
	select ATH79_DEV_WMAC
	help
	  Say 'Y' here if you want your kernel to support the
	  Atheros AP121 reference board.

config ATH79_MACH_AP136
	bool "Atheros AP136 reference board"
	select SOC_QCA955X
	select ATH79_DEV_GPIO_BUTTONS
	select ATH79_DEV_LEDS_GPIO
	select ATH79_DEV_SPI
	select ATH79_DEV_USB
	select ATH79_DEV_WMAC
	help
	  Say 'Y' here if you want your kernel to support the
	  Atheros AP136 reference board.

config ATH79_MACH_AP81
	bool "Atheros AP81 reference board"
	select SOC_AR913X
	select ATH79_DEV_GPIO_BUTTONS
	select ATH79_DEV_LEDS_GPIO
	select ATH79_DEV_SPI
	select ATH79_DEV_USB
	select ATH79_DEV_WMAC
	help
	  Say 'Y' here if you want your kernel to support the
	  Atheros AP81 reference board.

config ATH79_MACH_DB120
	bool "Atheros DB120 reference board"
	select SOC_AR934X
	select ATH79_DEV_GPIO_BUTTONS
	select ATH79_DEV_LEDS_GPIO
	select ATH79_DEV_SPI
	select ATH79_DEV_USB
	select ATH79_DEV_WMAC
	help
	  Say 'Y' here if you want your kernel to support the
	  Atheros DB120 reference board.

config ATH79_MACH_PB44
	bool "Atheros PB44 reference board"
	select SOC_AR71XX
	select ATH79_DEV_GPIO_BUTTONS
	select ATH79_DEV_LEDS_GPIO
	select ATH79_DEV_SPI
	select ATH79_DEV_USB
	help
	  Say 'Y' here if you want your kernel to support the
	  Atheros PB44 reference board.

config ATH79_MACH_UBNT_XM
	bool "Ubiquiti Networks XM (rev 1.0) board"
	select SOC_AR724X
	select ATH79_DEV_GPIO_BUTTONS
	select ATH79_DEV_LEDS_GPIO
	select ATH79_DEV_SPI
	help
	  Say 'Y' here if you want your kernel to support the
	  Ubiquiti Networks XM (rev 1.0) board.

config ATH79_MACH_MERAKI_MR12
	bool "Meraki MR12 access point"
	select SOC_AR724X
	select ATH79_MACH_MERAKI
	select ATH79_DEV_GPIO_BUTTONS
	select ATH79_DEV_LEDS_GPIO
	select ATH79_DEV_SPI
	help
	  Say 'Y' here if you want your kernel to support the
	  Meraki MR12 access point.

config ATH79_MACH_MERAKI_MR11_MR14
	bool "Meraki MR11/MR14 access point"
	select SOC_AR71XX
	select ATH79_MACH_MERAKI
	select ATH79_DEV_GPIO_BUTTONS
	select ATH79_DEV_LEDS_GPIO
	select ATH79_DEV_SPI
	help
	  Say 'Y' here if you want your kernel to support the
	  Meraki MR11 and MR14 access points.

config ATH79_MACH_MERAKI_MR16
	bool "Meraki MR16 access point"
	select SOC_AR71XX
	select ATH79_MACH_MERAKI
	select ATH79_DEV_GPIO_BUTTONS
	select ATH79_DEV_LEDS_GPIO
	select ATH79_DEV_SPI
	help
	  Say 'Y' here if you want your kernel to support the
	  Meraki MR16 access point.

config ATH79_MACH_MERAKI_MR18
	bool "Meraki MR18 access point"
	select SOC_QCA955X
	select ATH79_MACH_MERAKI
	select ATH79_DEV_GPIO_BUTTONS
	select ATH79_DEV_LEDS_GPIO
	select ATH79_DEV_SPI
	select BOOT_NAND_LOADER
	help
	  Say 'Y' here if you want your kernel to support the
	  Meraki MR18 access point.

config MR18_RADIOS
	tristate "MR18 Radio Initialization"
	depends on ATH79_MACH_MERAKI_MR18
	default m
	help
	  MR18 radio initialization from caldata MTD

config ATH79_MACH_MERAKI_Z1
	bool "Meraki Z1"
	select SOC_AR934X
	select ATH79_DEV_GPIO_BUTTONS
	select ATH79_DEV_LEDS_GPIO
	select ATH79_DEV_SPI
	select ATH79_DEV_USB
	select ATH79_DEV_WMAC
	select ATH79_DEV_XLNA
	select BOOT_NAND_LOADER
	help
	  Say 'Y' here if you want your kernel to support the
	  Meraki Z1.

endmenu

config SOC_AR71XX
	select USB_ARCH_HAS_EHCI
	select USB_ARCH_HAS_OHCI
	select HW_HAS_PCI
	def_bool n

config SOC_AR724X
	select USB_ARCH_HAS_EHCI
	select USB_ARCH_HAS_OHCI
	select HW_HAS_PCI
	select PCI_AR724X if PCI
	def_bool n

config SOC_AR913X
	select USB_ARCH_HAS_EHCI
	def_bool n

config SOC_AR933X
	select USB_ARCH_HAS_EHCI
	def_bool n

config SOC_AR934X
	select USB_ARCH_HAS_EHCI
	select HW_HAS_PCI
	select PCI_AR724X if PCI
	def_bool n

config SOC_QCA955X
	select USB_ARCH_HAS_EHCI
	select HW_HAS_PCI
	select PCI_AR724X if PCI
	def_bool n

config PCI_AR724X
	def_bool n

config ATH79_DEV_GPIO_BUTTONS
	def_bool n

config ATH79_DEV_LEDS_GPIO
	def_bool n

config ATH79_DEV_SPI
	def_bool n

config ATH79_DEV_USB
	def_bool n

config ATH79_DEV_WMAC
	depends on (SOC_AR913X || SOC_AR933X || SOC_AR934X || SOC_QCA955X)
	def_bool n

config ATH79_DEV_XLNA
	depends on (SOC_AR934X)
	def_bool n

config ATH79_MACH_MERAKI
	def_bool n

config BOOT_NAND_LOADER
	depends on (SOC_AR934X || SOC_QCA955X)
	def_bool n

endif
```

## arch/mips/atheros/Kconfig
```kconfig
config BOOT_NAND_LOADER
       bool "Generate a second stage single-block NAND loader"
       depends on SOC_AR934x
       help
          Create an image suitable for the Atheros ROM loader to read off
          of NAND flash and continue bootstrapping.

config BOOT_NAND_LOADER
       bool
```

## arch/powerpc/sysdev/Kconfig
```kconfig
# For a description of the syntax of this configuration file,
# see Documentation/kbuild/kconfig-language.txt.
#

config PPC4xx_PCI_EXPRESS
	bool
	depends on PCI && 4xx
	default n

config MERAKI_PPC4xx_PCI_EXPRESS_INIT
    bool "MERAKI Enable init code in PPC4xx_PCI"
    depends on PPC4xx_PCI_EXPRESS
    default n
    help
      Enable code in ppc4xx_pci.c to initialize the PCI bus
      for the Meraki MX64 platform

config PPC4xx_MSI
	bool
	depends on PCI_MSI
	depends on PCI && 4xx
	default n

config PPC_MSI_BITMAP
	bool
	depends on PCI_MSI
	default y if MPIC
	default y if FSL_PCI
	default y if PPC4xx_MSI

source "arch/powerpc/sysdev/xics/Kconfig"

config PPC_SCOM
	bool

config SCOM_DEBUGFS
	bool "Expose SCOM controllers via debugfs"
	depends on PPC_SCOM
	default n

config GE_FPGA
	bool
	default n
```

## arch/powerpc/sysdev/apmqm/Kconfig
```kconfig
# For a description of the syntax of this configuration file,
# see Documentation/kbuild/kconfig-language.txt.
#

config APMQM
        tristate "APM 86xxx QM driver"
        default n
        help
          This option enables APM86xxx Queue Manager (QM) driver support 
          requires for APM86xxx DMA, Ethernet, and security hardware.

if APMQM
config	QM_IRQ_COALECING
	tristate "APM 86xxx QM driver interrupt coalescing"
	default n
	help
	  This option enables interrupt coalescing for APM86xxx Queue Manager.

config APMQM_CFG
        tristate "APM 86xxx QM Configuration Driver"
	depends on APMQM
        default y 
        help
          This option enables APM86xxx Queue Manager (QM) configuration
	  driver.
endif
```

## block/Kconfig.sbull
```kconfig
menu "sbull Driver"

config SBULL
	tristate "Sbull Device Support"
	---help---
	This enables support for accessing all type of sbull
	  devices.

endmenu
```

## drivers/crypto/qat/Kconfig
```kconfig
config CRYPTO_DEV_QAT
	tristate
	select CRYPTO_AEAD
	select CRYPTO_AUTHENC
	select CRYPTO_BLKCIPHER
	select CRYPTO_AKCIPHER
	select CRYPTO_HMAC
	select CRYPTO_SHA1
	select CRYPTO_SHA256
	select CRYPTO_SHA512
	select FW_LOADER
	select ASN1

config CRYPTO_DEV_QAT_IN_TREE
	tristate "Support for linux in-tree QAT drivers"
	depends on !CRYPTO_DEV_QAT_1_7
	help
	  Enables support for linux in-tree drivers for Intel's
	  QuickAssist Technology (QAT). These do not have support
	  for Monster Mash (mx250b, mx450b) HW crypto offload.

	  Enabling this for Monster Mash builds will greatly reduce
	  VPN throughput performance, and cannot be used in combination
	  with QAT1.7 which does support Monser Mash.

config CRYPTO_DEV_QAT_DH895xCC
	tristate "Support for Intel(R) DH895xCC"
	depends on CRYPTO_DEV_QAT_IN_TREE && X86 && PCI
	select CRYPTO_DEV_QAT
	help
	  Support for Intel(R) DH895xcc with Intel(R) QuickAssist Technology
	  for accelerating crypto and compression workloads.

	  To compile this as a module, choose M here: the module
	  will be called qat_dh895xcc.

config CRYPTO_DEV_QAT_C3XXX
	tristate "Support for Intel(R) C3XXX"
	depends on CRYPTO_DEV_QAT_IN_TREE && X86 && PCI
	select CRYPTO_DEV_QAT
	help
	  Support for Intel(R) C3xxx with Intel(R) QuickAssist Technology
	  for accelerating crypto and compression workloads.

	  To compile this as a module, choose M here: the module
	  will be called qat_c3xxx.

config CRYPTO_DEV_QAT_C62X
	tristate "Support for Intel(R) C62X"
	depends on CRYPTO_DEV_QAT_IN_TREE && X86 && PCI
	select CRYPTO_DEV_QAT
	help
	  Support for Intel(R) C62x with Intel(R) QuickAssist Technology
	  for accelerating crypto and compression workloads.

	  To compile this as a module, choose M here: the module
	  will be called qat_c62x.

config CRYPTO_DEV_QAT_DH895xCCVF
	tristate "Support for Intel(R) DH895xCC Virtual Function"
	depends on CRYPTO_DEV_QAT_IN_TREE && X86 && PCI
	select PCI_IOV
	select CRYPTO_DEV_QAT

	help
	  Support for Intel(R) DH895xcc with Intel(R) QuickAssist Technology
	  Virtual Function for accelerating crypto and compression workloads.

	  To compile this as a module, choose M here: the module
	  will be called qat_dh895xccvf.

config CRYPTO_DEV_QAT_C3XXXVF
	tristate "Support for Intel(R) C3XXX Virtual Function"
	depends on CRYPTO_DEV_QAT_IN_TREE && X86 && PCI
	select PCI_IOV
	select CRYPTO_DEV_QAT
	help
	  Support for Intel(R) C3xxx with Intel(R) QuickAssist Technology
	  Virtual Function for accelerating crypto and compression workloads.

	  To compile this as a module, choose M here: the module
	  will be called qat_c3xxxvf.

config CRYPTO_DEV_QAT_C62XVF
	tristate "Support for Intel(R) C62X Virtual Function"
	depends on CRYPTO_DEV_QAT_IN_TREE && X86 && PCI
	select PCI_IOV
	select CRYPTO_DEV_QAT
	help
	  Support for Intel(R) C62x with Intel(R) QuickAssist Technology
	  Virtual Function for accelerating crypto and compression workloads.

	  To compile this as a module, choose M here: the module
	  will be called qat_c62xvf.

config CRYPTO_DEV_QAT_1_7
	tristate "Support for Intel(R) QAT1.7 Devices Select to support Monster Mash devices (mx250b, mx450b)"
	depends on X86 && PCI
	default m
	select ASN1
	help
	  Support for Intel(R) QuickAssist Technology
	  for accelerating crypto and compression workloads for Monsters
	  and Monster Mash boards.

	  To compile this as a module, choose M here. This will compile all QAT1.7
	  supported modules.
```

## drivers/dsp/syslink/Kconfig
```kconfig
menuconfig Sys_Link
	bool "Sys_Link"
	depends on ARCH_OMAP4 || ARCH_OMAP3 ||ARCH_TI81XX
	default y

if Sys_Link

config  SYSLINK_MULTIPROC
        bool
		depends on ARCH_OMAP3430 || ARCH_OMAP4 ||ARCH_TI81XX
		default n

config SYSLINK_NOTIFY
		tristate "SysLink Notify"
		depends on ARCH_OMAP3430 || ARCH_OMAP4 ||ARCH_TI81XX
		default y
		select OMAP_MBOX_FWK
		select SYSLINK_MULTIPROC
		select OMAP_IOMMU
		select OMAP_USER_DMM
		select OMAP_IOMMU_IVA2 if ARCH_OMAP3430
		help
		 Syslink multi core notify Implementation

endif
```

## drivers/i2c/muxes/Kconfig
```kconfig
#
# Multiplexer I2C chip drivers configuration
#

menu "Multiplexer I2C Chip support"
	depends on I2C_MUX

config I2C_MUX_GPIO
	tristate "GPIO-based I2C multiplexer"
	depends on GENERIC_GPIO
	help
	  If you say yes to this option, support will be included for a
	  GPIO based I2C multiplexer. This driver provides access to
	  I2C busses connected through a MUX, which is controlled
	  through GPIO pins.

	  This driver can also be built as a module.  If so, the module
	  will be called gpio-i2cmux.

config I2C_GPIO_SCL
       boolean "GPIO-based SCL multiplexer"
       depends on I2C_GPIO
       help
         If you say yes to this option, support will be included for a
         GPIO based I2C multiplexer and adapter, where the method of
         multiplexing is multiple I2C busses with separate SCL lines
         and a shared SDA line. This driver relies on the i2c-gpio
         driver to handle communication across the busses.

         This driver cannot be built as a module yet.

endmenu
```

## drivers/media/video/ti81xx/Kconfig
```kconfig
config VIDEO_TI81XX_VIDOUT
	tristate "TI81XX V4L2-Display driver"
	depends on ARCH_TI81XX
	select TI81XX_VPSS
	select VIDEOBUF_GEN
	select VIDEOBUF_DMA_CONTIG
	default n
	---help---
	  V4L2 Display driver support for TI81XX based boards.
config VIDEO_TI81XX_VIDIN
	tristate "TI81XX V4L2-Capture driver"
	depends on ARCH_TI81XX
	select TI81XX_VPSS
	select VIDEOBUF_GEN
	select VIDEOBUF_DMA_CONTIG
	select VIDEO_TVP7002
	default n
	---help---
	  V4L2 Capture driver support for TI81XX based boards.
```

## drivers/meraki/Kconfig
```kconfig
menu "Meraki devices"

config MERAKI_CONFIG
	tristate "Meraki Board Data support"
	depends on I2C
	help
	  This option enables support for the meraki-config device, which
	  proxies the content of the board ID EEPROM to a known location.

	  It also provides kernel access to the Meraki product type.

	  If your board has a board ID EEPROM on it, say Y here.

config CISCO_MPS
    bool "Cisco MPS Support"
    depends on POWER_SUPPLY
    help
      This is a driver for an I2C-connected MPS device

config MERAKI_SFP_USER
       bool "Meraki SFP/SFP+ Socket Support (user-mode)"
       depends on I2C && GPIOLIB
       help
         This is a proxy driver for an I2C-connected SFP/SFP+/QSFP socket.
         The actual driving of the socket will be performed in userspace.

config MERAKI_MS420_PSU
        tristate "Cisco Meraki MS420 field-replaceable power supply"
        depends on I2C && SENSORS_PMBUS
        default n
        help
          If you say yes here you get hardware monitoring support for the
          field-replaceable power supplies provided with the Cisco Meraki
          MS420 series switches.

          This driver can also be built as a module. If so, the module will
          be called ms420_psu.

config CISCO_ACT2
       bool "Cisco ACT2 support"
       default n
       help
         This is a driver to communicate with the Cisco ACT2 security chip.
         The device is used for various types of encryption. It has on-board,
         protected EEPROM so it can generate and securely store keys.

config CISCO_ACT2_I2C
	bool "Cisco ACT2 I2C support"
	depends on I2C && CISCO_ACT2
	default n
	help
         This is a driver to communicate with the Cisco ACT2 security chip.
         The device is used for various types of encryption. It has on-board,
         protected EEPROM so it can generate and securely store keys.

         This is an I2C-connected device.

config CISCO_ACT2_SPI
	bool "Cisco ACT2 SPI support"
	depends on SPI && CISCO_ACT2
	default n
	help
         This is a driver to communicate with the Cisco ACT2 security chip.
         The device is used for various types of encryption. It has on-board,
         protected EEPROM so it can generate and securely store keys.

         This is an SPI-connected device.

config CISCO_ACT2_LPC
	bool "Cisco ACT2 LPC support"
	depends on CISCO_ACT2
	default n
	help
         This is a driver to communicate with the Cisco ACT2 security chip.
         The device is used for various types of encryption. It has on-board,
         protected EEPROM so it can generate and securely store keys.

         This is an LPC-connected device.

endmenu
```
