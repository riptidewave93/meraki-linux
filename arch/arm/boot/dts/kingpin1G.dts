/*
 * Copyright (C) 2014 Meraki, Inc.
 *
 * This program is free software; you can redistribute it and/or modify
 * it under the terms of the GNU General Public License version 2 as
 * published by the Free Software Foundation.
 */
/dts-v1/;

/include/ "kingpin.dtsi"

/ {
        model = "Meraki MX64";
        compatible = "meraki,mx6p", "meraki,kingpin", "meraki,wired-arm-nsp",
			"broadcom,iproc", "bcm,iproc";
        memory {
                device_type = "memory";
                reg = <0x80000000 0x1fff0000>;
        };
};
