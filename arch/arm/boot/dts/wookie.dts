/*
* Copyright (C) 2015 Meraki, Inc.
*
* This program is free software; you can redistribute it and/or modify
* it under the terms of the GNU General Public License version 2 as
* published by the Free Software Foundation.
*/
/dts-v1/;

/include/ "cryptid-aq105.dtsi"

/ {
	model = "Meraki Wookie";
	compatible = "meraki,wookie", "meraki,cryptid-aq105", "meraki,cryptid", "qcom,ipq806x";
};
