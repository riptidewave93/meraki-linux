## drivers/soc/Kconfig
```kconfig
menu "SOC (System On Chip) specific Drivers"

source "drivers/soc/brcmstb/Kconfig"
source "drivers/soc/mediatek/Kconfig"
if ARCH_QCOM
source "drivers/soc/qcom/Kconfig"
endif
source "drivers/soc/rockchip/Kconfig"
source "drivers/soc/sunxi/Kconfig"
source "drivers/soc/ti/Kconfig"
source "drivers/soc/versatile/Kconfig"

endmenu
```

## drivers/test/Kconfig
```kconfig
menu "PPC4xx Self Test support"

config PPC4xx_TEST
	tristate "PowerPC 4xx Self Test support"
	help
	  PPC4xx self tests are kernel drivers which can be built into the
	  kernel, or can be built as seperate driver modules.  If these
	  drivers are built into the kernel, then they are run when the
	  kernel loads the test drivers.  If these test drivers are built
	  as modules, then use insmod to load and execute the test drivers.

config PPC4xx_L2CACHE_TEST
	tristate "PowerPC 4xx L2 Cache Self Test support"
	depends on PPC4xx_TEST
	help
	  If you say Y here, you will get support for
	  the L2 Cache self test interface. See driver for
	  more information.

endmenu
```

## drivers/thermal/Kconfig
```kconfig
#
# Generic thermal sysfs drivers configuration
#

menuconfig THERMAL
	tristate "Generic Thermal sysfs driver"
	help
	  Generic Thermal Sysfs driver offers a generic mechanism for
	  thermal management. Usually it's made up of one or more thermal
	  zone and cooling device.
	  Each thermal zone contains its own temperature, trip points,
	  cooling devices.
	  All platforms with ACPI thermal support can use this driver.
	  If you want this support, you should say Y or M here.

config THERMAL_HWMON
	bool
	depends on THERMAL
	depends on HWMON=y || HWMON=THERMAL
	default y

config THERMAL_MONITOR
	bool "Monitor thermal state and limit CPU Frequency"
	depends on THERMAL_TSENS8960 || THERMAL_TSENS8974
	depends on CPU_FREQ_MSM
	default n
	help
	  This enables thermal monitoring capability in the kernel in the
	  absence of a system wide thermal monitoring entity or until such an
	  entity starts running in the userspace. Monitors TSENS temperature
	  and limits the max frequency of the cores.

config SPEAR_THERMAL
	bool "SPEAr thermal sensor driver"
	depends on THERMAL
	depends on PLAT_SPEAR
	help
	  Enable this to plug the SPEAr thermal sensor driver into the Linux
	  thermal framework
```

## drivers/video/ti81xx/Kconfig
```kconfig
source "drivers/video/ti81xx/vpss/Kconfig"
source "drivers/video/ti81xx/ti81xxfb/Kconfig"
source "drivers/video/ti81xx/ti81xxhdmi/Kconfig"
source "drivers/video/ti81xx/sii9022a/Kconfig"
source "drivers/video/ti81xx/tlc59108/Kconfig"
```

## drivers/video/ti81xx/sii9022a/Kconfig
```kconfig
config SII9022a
	tristate "SII9022a HDMI Transmitter"
	help
		This option builds driver for SII9022a HDMI Transmitter
		Use 'M' to build as module.
```

## drivers/video/ti81xx/ti81xxhdmi/Kconfig
```kconfig
menuconfig TI81XX_HDMI
	tristate "TI81XX HDMI Driver"
	select TI81XX_VPSS
	help
		This option builds driver required for booting TI81XX HDMI
		Use 'M' to build as module.

config TI81XX_HDMI_HDCP
	bool "Include HDCP support"
	default n
	depends on TI81XX_HDMI
	---help---
		Support for HDCP block of HDMI to be included. Ensure a device
		capable of HDCP is being used, failing which the behaviour of
		the driver is un-defined.
```

## drivers/video/ti81xx/tlc59108/Kconfig
```kconfig
config TLC59108
	tristate "TLC59108 LCD/Backlight"
	depends on BACKLIGHT_CLASS_DEVICE
	help
		This option builds driver for TLC59108 LCD/Backlight
		Use 'M' to build as module.
```
